## config/west.yml
```yaml
manifest:
  defaults:
    revision: v0.3
  remotes:
    - name: zmkfirmware
      url-base: https://github.com/zmkfirmware
    - name: badjeff
      url-base: https://github.com/badjeff
    - name: hsgw
      url-base: https://github.com/hsgw
    - name: caksoylar # <-- led
      url-base: https://github.com/caksoylar

  projects:
    # ZMK 本体。公式の app/west.yml を取り込む
    - name: zmk
      remote: zmkfirmware
      revision: v0.3.0
      import: app/west.yml

    # PMW3610 ドライバ（外部モジュール）
    - name: zmk-pmw3610-driver
      remote: badjeff
      revision: main

    # Sensor-rotation
    - name: zmk-feature-sensor_rotation
      remote: hsgw
      revision: main

    # LED
    - name: zmk-rgbled-widget # <-- led
      remote: caksoylar
      revision: main

  self:
    path: config
```

## trackball_module/Kconfig
```kconfig
menu "KobitoKey Trackball Helpers"

config KOBITOKEY_DIR_KEY_PROCESSOR
    bool "Enable directional key processor for trackballs"
    default y

endmenu
```

## trackball_module/dts/bindings/input/zmk,input-processor-dir-keys.yaml
```yaml
# Copyright (c) 2024
# SPDX-License-Identifier: MIT

description: Convert relative pointing movement into directional key bindings

compatible: "zmk,input-processor-dir-keys"

include: ip_zero_param.yaml

properties:
  x-code:
    type: int
    description: Relative input code used for the horizontal axis (default INPUT_REL_X)
  y-code:
    type: int
    description: Relative input code used for the vertical axis (default INPUT_REL_Y)
  threshold:
    type: int
    description: Amount of movement units required before firing a binding (default 8)
  bindings:
    type: phandle-array
    required: true
    description: >
      Four bindings ordered as X+, X-, Y+, Y-. Use &none for directions you want to ignore.
```
